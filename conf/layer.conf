## conf/layer.conf
```bitbake
DEFAULT_BUILD_VARIANT ?= "full"

QTI_NAD_TELAF_ENABLE = "${@bb.utils.contains('COMBINED_FEATURES', 'qti-nad-telaf', '1', '0', d)}"

BUILD_VARIANT = "${@ d.getVar('DEFAULT_BUILD_VARIANT') \
    if d.getVar('QTI_NAD_TELAF_ENABLE') == '1' else 'null' }"

BBFILES += "${@bb.utils.contains('BUILD_VARIANT', 'full', \
    '${LAYERDIR}/recipes/*/*.bb ${LAYERDIR}/recipes/*/*.bbappend ${LAYERDIR}/recipes-*/*.bb ${LAYERDIR}/recipes-products/images/*.bbappend ${LAYERDIR}/recipes-*/*.bbappend', \
    '', d)}"

BBFILES += "${@bb.utils.contains('BUILD_VARIANT', 'minimal', \
    '${LAYERDIR}/recipes/telaf-image/telaf-image.bb \
     ${LAYERDIR}/recipes/telaf-init/telaf-init.bb \
     ${LAYERDIR}/recipes/packagegroups/packagegroup-qti-telaf.bb', \
    '', d)}"

BBPATH .= ":${LAYERDIR}"
BBFILE_COLLECTIONS += "telaf"
BBFILE_PRIORITY_telaf = "30"
BBFILE_PATTERN_telaf = "^${LAYERDIR}/"

LAYERVERSION_telaf = "1"
LAYERSERIES_COMPAT_telaf = "${LAYERSERIES_COMPAT_core}"
```
